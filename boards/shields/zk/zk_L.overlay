#include <dt-bindings/zmk/matrix_transform.h>
#include <dt-bindings/zmk/input_transform.h>
#include <input/processors.dtsi>
#include <zephyr/dt-bindings/input/input-event-codes.h>
#include <physical_layouts.dtsi>
#include "zk.dtsi"

/ {
    chosen {
        zmk,physical-layout = &default_layout;
    };

    split_inputs {
        #address-cells = <1>;
        #size-cells = <0>;

        trackball_split: trackball_split@0 {
            compatible = "zmk,input-split";
            reg = <0>;
        };
    };

    left_encoder_bottom: left_encoder_bottom {
        compatible = "alps,ec11";
        a-gpios = <&xiao_d 10 (GPIO_ACTIVE_HIGH | GPIO_PULL_UP)>;
        b-gpios = <&xiao_d 9  (GPIO_ACTIVE_HIGH | GPIO_PULL_UP)>;
        steps = <12>;
        status = "okay";
    };

    left_encoder_side: left_encoder_side {
        compatible = "alps,ec11";
        a-gpios = <&xiao_d 8 (GPIO_ACTIVE_HIGH | GPIO_PULL_UP)>;
        b-gpios = <&xiao_d 7 (GPIO_ACTIVE_HIGH | GPIO_PULL_UP)>;
        steps = <24>;
        status = "okay";
    };

    sensors: sensors {
        compatible = "zmk,keymap-sensors";
        sensors = <&left_encoder_bottom &left_encoder_side>;
        triggers-per-rotation = <10>;
    };

/* ===== kscan ===== */
&kscan0 {
    col-gpios =
        <&xiao_d 10 GPIO_ACTIVE_HIGH>,
        <&xiao_d 9  GPIO_ACTIVE_HIGH>,
        <&xiao_d 8  GPIO_ACTIVE_HIGH>,
        <&xiao_d 7  GPIO_ACTIVE_HIGH>,
        <&gpio0 10  GPIO_ACTIVE_HIGH>,
        <&gpio0 9   GPIO_ACTIVE_HIGH>;
};




/* ===== UART disable ===== */
&xiao_serial { status = "disabled"; };
&uart0 { status = "disabled"; };
